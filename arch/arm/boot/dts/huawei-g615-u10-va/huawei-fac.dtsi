 / {
        huawei_fac_info {
                  compatible = "huawei,hw_fac_info";
                  fac,product_name = "G615_U10";
                  fac,hardware_ver = "HS1G620M_VERA";
		  fac,software_ver = "MSM8x12_G615_U10_va";
                  status = "ok";
        };
};
