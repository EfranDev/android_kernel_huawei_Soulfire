&soc{
	i2c@f9923000{
		synaptics@70 {
			compatible = "synaptics,rmi4";
			reg = <0x70>;
			interrupt-parent = <&msmgpio>;
			interrupts = <1 0x2>;
			vdd-supply = <&pm8110_l19>;
			vcc_i2c-supply = <&pm8110_l14>;
			synaptics,vdd = "vdd";
			synaptics,vbus = "vcc_i2c";
			synaptics,reset_gpio_num = <0>;
			synaptics,irq_gpio_num = <1>;
			synaptics,irq_gpio_polarity = <0>;/*attn_polarity =RMI_ATTN_ACTIVE_LOW,add irq trigger=IRQF_TRIGGER_FALLING*/

			synaptics,lcd-x = <480>;
			synaptics,lcd-y = <854>;
			synaptics,lcd-all = <922>;
			synaptics,virtual_keys = /* KeyCode CenterX CenterY Width Height */
				/* KEY_BACK */
				<158 85 900 120 60
				/* KEY_HOME(102) */
				102 240 900 120 60
				/* KEY_MENU */
				139 405 900 120 60>;

			synaptics,reset-delay-ms = <50>;
			synaptics,reset-active-ms = <10>;
			synaptics,power-delay-ms = <1000>;
			synaptics,pr-version = <1191601>;
			/*Poision:TP-COF = 0x0,TP_COB = 0x1,TP_MAX = 0xF*/
			synaptics,ic-name = <2202>;
			synaptics,ic-position = <0x1>;
			synaptics,firmware-name = "synaptics_fw_y530.img";
		};
	};
};
